/*@!Encoding:1252*/
includes
{
  
}

variables
{
  
}

on start
{
  write("simulation started")
}

